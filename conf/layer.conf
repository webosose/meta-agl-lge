## conf/layer.conf
```bitbake
# We have a conf and classes directory, add to BBPATH
BBPATH =. "${LAYERDIR}:"

# We have recipes-* directories, add to BBFILES
BBFILES += "${LAYERDIR}/recipes-*/*/*.bb \
            ${LAYERDIR}/recipes-*/*/*.bbappend"

BBFILE_COLLECTIONS += "agl-demo-wam"
BBFILE_PATTERN_agl-demo-wam = "^${LAYERDIR}/"
BBFILE_PRIORITY_agl-demo-wam = "7"
```
